ASAP2_VERSION 1 6
/begin PROJECT RC30 ""
/begin HEADER "" VERSION "0" PROJECT_NO RC30 /end HEADER
/begin MODULE CCP ""
/begin MOD_COMMON "" BYTE_ORDER MSB_LAST ALIGNMENT_BYTE 1 ALIGNMENT_WORD 2 ALIGNMENT_LONG 4 ALIGNMENT_INT64 8 ALIGNMENT_FLOAT32_IEEE 4 ALIGNMENT_FLOAT64_IEEE 8 /end MOD_COMMON
/begin IF_DATA ASAP1B_CCP
 /begin SOURCE "event triggered" 103 1 /begin QP_BLOB 0 LENGTH 10 CAN_ID_FIXED 0x330 FIRST_PID 0 RASTER 0 /end QP_BLOB /end SOURCE
 /begin SOURCE "10ms time synchronous" 4 1 /begin QP_BLOB 1 LENGTH 15 CAN_ID_FIXED 0x340 FIRST_PID 10 RASTER 1 /end QP_BLOB /end SOURCE
 /begin SOURCE "100ms time synchronous" 4 10 /begin QP_BLOB 2 LENGTH 15 CAN_ID_FIXED 0x350 FIRST_PID 25 RASTER 2 /end QP_BLOB /end SOURCE
 /begin RASTER "event triggered" "even_trig" 0 103 1 /end RASTER
 /begin RASTER "10ms time synchronous" "10_ms" 1 4 1 /end RASTER
 /begin RASTER "100ms time synchronous" "100_ms" 2 4 10 /end RASTER
 /begin SEED_KEY /* seed&key dll for CAL */ "" /* seed&key dll for DAQ */ "" /* seed&key dll for PGM */ "" /end SEED_KEY
 /begin TP_BLOB /* CCP version */ 0x201 /* Blob version */ 0x204 /* CAN msg ID-send */ 0x310 /* CAN msg ID-recv */ 0x320 /* station address */ 0x1 /* byte order */ 2 BAUDRATE 1000000 /* in Hz */ SAMPLE_POINT 80 /* in % */ SAMPLE_RATE 1 /* 1 or 3 */ BTL_CYCLES 20 SJW 2 SYNC_EDGE SINGLE /* SINGLE or DUAL */ DAQ_MODE BURST CONSISTENCY DAQ
  /begin CHECKSUM_PARAM /* algorithm */ 0xC001 /* limit */ 0xFFFFFFFF CHECKSUM_CALCULATION ACTIVE_PAGE /end CHECKSUM_PARAM
  /begin DEFINED_PAGES /* page number */ 1 /* page name */ "reference page" /* address ext. */ 0x0 /* base address */ 0x82006010 /* page length */ 0x38000 ROM /end DEFINED_PAGES
  /begin DEFINED_PAGES /* page number */ 2 /* page name */ "working page" /* address ext. */ 0x0 /* base address */ 0x48000 /* page length */ 0x38000 RAM RAM_INIT_BY_ECU /end DEFINED_PAGES
  OPTIONAL_CMD 0x5 /* TEST */ OPTIONAL_CMD 0x8 /* START_STOP_ALL */ OPTIONAL_CMD 0x9 /* GET_ACTIVE_CAL_PAGE */ OPTIONAL_CMD 0xC /* SET_S_STATUS */ OPTIONAL_CMD 0xD /* GET_S_STATUS */ OPTIONAL_CMD 0xE /* BUILD_CHKSUM */ OPTIONAL_CMD 0xF /* SHORT_UPLOAD */ OPTIONAL_CMD 0x11 /* SELECT_CAL_PAGE */ OPTIONAL_CMD 0x12 /* GET_SEED */ OPTIONAL_CMD 0x13 /* UNLOCK */ OPTIONAL_CMD 0x19 /* MOVE */ OPTIONAL_CMD 0x23 /* DNLOAD_6 */ /end TP_BLOB
/end IF_DATA
/* Overrides for ATI VISION */
/begin IF_DATA VISION DEVICE_SETTING "CCP=2.1FixedDaqLists" DEVICE_SETTING "CCP_Event1=even_trig, 1, 1" DEVICE_SETTING "CCP_FixedDaqList1=even_trig, 0, 17, 0, 0, 0, 1, 1, 0x330" DEVICE_SETTING "CCP_FixedDaqList2=10_ms, 1, 26, 0, 10, 10, 1, 1, 0x340" DEVICE_SETTING "CCP_FixedDaqList3=100_ms, 2, 46, 0, 25, 100, 2, 1, 0x350" /end IF_DATA
/begin RECORD_LAYOUT Kw_Ws16 FNC_VALUES 1 SWORD COLUMN_DIR DIRECT /end RECORD_LAYOUT
/begin RECORD_LAYOUT ValA_Ws16 FNC_VALUES 1 SWORD COLUMN_DIR DIRECT /end RECORD_LAYOUT
/begin RECORD_LAYOUT ValA_Wu16 FNC_VALUES 1 UWORD COLUMN_DIR DIRECT /end RECORD_LAYOUT
/begin RECORD_LAYOUT ValA_Wu8 FNC_VALUES 1 UBYTE COLUMN_DIR DIRECT /end RECORD_LAYOUT
/begin RECORD_LAYOUT Val_Ws16 FNC_VALUES 1 SWORD COLUMN_DIR DIRECT /end RECORD_LAYOUT
/begin RECORD_LAYOUT Val_Wu16 FNC_VALUES 1 UWORD COLUMN_DIR DIRECT /end RECORD_LAYOUT
/begin RECORD_LAYOUT Val_Wu32 FNC_VALUES 1 ULONG COLUMN_DIR DIRECT /end RECORD_LAYOUT
/begin RECORD_LAYOUT Val_Wu8 FNC_VALUES 1 UBYTE COLUMN_DIR DIRECT /end RECORD_LAYOUT
/end MODULE
/end PROJECT
